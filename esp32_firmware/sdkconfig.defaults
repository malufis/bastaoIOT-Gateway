## k10_firmware/sdkconfig.defaults
```kconfig
# SDKConfig defaults para K10 Bastao Unihiker
CONFIG_ESPTOOLPY_FLASHSIZE_16MB=y
CONFIG_ESPTOOLPY_FLASHSIZE="16MB"
CONFIG_IDF_TARGET="esp32s3"
CONFIG_IDF_TARGET_ESP32S3=y

# Partition Table (3MB factory + 2MB SPIFFS)
CONFIG_PARTITION_TABLE_CUSTOM=y
CONFIG_PARTITION_TABLE_CUSTOM_FILENAME="partitions.csv"

# Log
CONFIG_LOG_DEFAULT_LEVEL_INFO=y
CONFIG_LOG_MAXIMUM_LEVEL_VERBOSE=y

# BT Controller
CONFIG_BT_ENABLED=y
CONFIG_BT_BTC_TASK_STACK_SIZE=4096
CONFIG_BT_BTU_TASK_STACK_SIZE=4608
CONFIG_BT_BLE_50_FEATURES_SUPPORTED=y
CONFIG_BT_BLE_42_FEATURES_SUPPORTED=y
CONFIG_BT_GATTS_SEND_SERVICE_CHANGE_MANUAL=y

# LVGL
CONFIG_LV_USE_LOG=n
CONFIG_LV_MEM_CUSTOM=y
CONFIG_LV_COLOR_DEPTH_16=y
CONFIG_LV_COLOR_16_SWAP=y
CONFIG_LV_FONT_MONTSERRAT_12=y
CONFIG_LV_FONT_MONTSERRAT_14=y
CONFIG_LV_FONT_MONTSERRAT_16=y
CONFIG_LV_FONT_MONTSERRAT_18=y
CONFIG_LV_FONT_MONTSERRAT_20=y
CONFIG_LV_FONT_MONTSERRAT_24=y

# BLE Mesh (Node para v5.4/v5.5)
CONFIG_BLE_MESH=y
CONFIG_BLE_MESH_HCI_5_0=y
CONFIG_BLE_MESH_V11_SUPPORT=y
CONFIG_BLE_MESH_DEINIT=y
CONFIG_BLE_MESH_SETTINGS=y
CONFIG_BLE_MESH_NODE=y
# CONFIG_BLE_MESH_PROVISIONER is not set
CONFIG_BLE_MESH_PROV=y
CONFIG_BLE_MESH_PB_ADV=y
CONFIG_BLE_MESH_PROXY=y
CONFIG_BLE_MESH_GATT_PROXY_SERVER=y
CONFIG_BLE_MESH_RELAY=y
CONFIG_BLE_MESH_HEALTH_SRV=y
CONFIG_BLE_MESH_SUBNET_COUNT=3
CONFIG_BLE_MESH_APP_KEY_COUNT=3
CONFIG_BLE_MESH_MODEL_KEY_COUNT=3
CONFIG_BLE_MESH_MODEL_GROUP_COUNT=3
CONFIG_BLE_MESH_LABEL_COUNT=3
CONFIG_BLE_MESH_CRPL=10
CONFIG_BLE_MESH_MSG_CACHE_SIZE=10
CONFIG_BLE_MESH_ADV_BUF_COUNT=60
CONFIG_BLE_MESH_IVU_DIVIDER=4
CONFIG_BLE_MESH_RX_SDU_MAX=384
CONFIG_BLE_MESH_RX_SEG_MSG_COUNT=12
CONFIG_BLE_MESH_TX_SEG_MSG_COUNT=12
CONFIG_BLE_MESH_TX_SEG_MAX=32
CONFIG_BLE_MESH_CLIENT_MSG_TIMEOUT=4000
CONFIG_BLE_MESH_DISCARD_OLD_SEQ_AUTH=y

# FreeRTOS
CONFIG_FREERTOS_HZ=1000
CONFIG_ESP_MAIN_TASK_STACK_SIZE=8192
```
